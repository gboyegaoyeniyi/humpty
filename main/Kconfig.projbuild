## main/Kconfig.projbuild
```kconfig
menu "GPIO PINs Configurations"

    config DHT_GPIO_PIN
        int "DHT11 sensor data pin"
        default 4
        range 0 30
        help
            The GPIO pin number to be connected to the DHT11 sensor data line.

    config OLED_SDA_PIN
        int "SDA pin for OLED I2C display"
        default 21
        range 0 30
        help
            The GPIO pin number to be connected to the displays SDA pin

    config OLED_SCL_PIN
        int "SCL pin for the OLED 12C display"
        default 22
        range 0 30
        help
            The GPIO pin number to be connected to the display SDA pin

endmenu
```
